## ports/zephyr/boards/nucleo_f429zi.conf
```kconfig
CONFIG_MICROPY_FROZEN_MODULES=y
CONFIG_MICROPY_FROZEN_MANIFEST="boards/nucleo_f429zi/manifest.py"
CONFIG_MICROPY_CONFIGFILE="boards/nucleo_f429zi/mpconfigport.h"
# flash config
CONFIG_FLASH=y
CONFIG_FLASH_MAP=y
CONFIG_FLASH_PAGE_LAYOUT=y

CONFIG_DEBUG_OPTIMIZATIONS=y
CONFIG_DEBUG_THREAD_INFO=y

CONFIG_NET_DEFAULT_IF_ETHERNET=y
CONFIG_NET_L2_ETHERNET=y
CONFIG_NET_IPV6=n
```
